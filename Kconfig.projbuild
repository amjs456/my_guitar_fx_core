## Kconfig.projbuild
```kconfig
menu "MY GUITAR FX Settings"
    config MAX_FX_COUNT
    int "MAX FX COUNT"
    default 8

    config MAX_FX_PARAM_COUNT
    int "MAX FX PARAM COUNT"
    default 16

endmenu
```
